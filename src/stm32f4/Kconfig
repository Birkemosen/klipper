## src/stm32f4/Kconfig
```kconfig
# Kconfig settings for STM32F4 processors

if MACH_STM32F4

config STM32F4_SELECT
    bool
    default y
    select HAVE_GPIO
    select HAVE_GPIO_ADC
    select HAVE_GPIO_SPI

config BOARD_DIRECTORY
    string
    default "stm32f4"

choice
    prompt "Processor model"
    config MACH_STM32F411
        bool "STM32F411 (100Mhz)"
    config MACH_STM32F446
        bool "STM32F446 (180Mhz)"
endchoice

config CLOCK_FREQ
    int
    default 8000000 if MACH_STM32F411 # 100000000
    default 32000000 if MACH_STM32F446 # 180000000

config SERIAL
    bool
    default y

config SERIAL_BAUD
    depends on SERIAL
    int "Baud rate for serial port"
    default 250000

endif
```

## src/stm32f4xx/Kconfig
```kconfig
# Kconfig settings for STM32F4 processors

if MACH_STM32F4xx

config STM32F4xx_SELECT
    bool
    default y
    select HAVE_GPIO
    select HAVE_GPIO_ADC

config BOARD_DIRECTORY
    string
    default "stm32f4xx"

config CLOCK_FREQ
    int
    default 18000000 # 32000000

config SERIAL
    bool
    default y

config SERIAL_BAUD
    depends on SERIAL
    int "Baud rate for serial port"
    default 250000

endif
```
